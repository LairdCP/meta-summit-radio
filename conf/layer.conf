## conf/layer.conf
```bitbake
# We have a conf and classes directory, add to BBPATH
BBPATH .= ":${LAYERDIR}"

# We have recipes-* directories, add to BBFILES
BBFILES += "${LAYERDIR}/recipes-*/*/*.bb \
	${LAYERDIR}/recipes-*/*/*.bbappend"

BBFILE_COLLECTIONS += "laird-cp"
BBFILE_PATTERN_laird-cp = "^${LAYERDIR}/"
BBFILE_PRIORITY_laird-cp = "8"
```

## meta-summit-radio-pre-3.4/conf/layer.conf
```bitbake
# We have a conf and classes directory, add to BBPATH
BBPATH .= ":${LAYERDIR}"

# We have recipes-* directories, add to BBFILES
BBFILES += "${LAYERDIR}/recipes-*/*/*.bb \
	${LAYERDIR}/recipes-*/*/*.bbappend"

BBFILE_COLLECTIONS += "summit-radio-pre-3.4"
BBFILE_PATTERN_summit-radio-pre-3.4 = "^${LAYERDIR}/"
BBFILE_PRIORITY_summit-radio-pre-3.4 = "8"

LAYERSERIES_COMPAT_summit-radio-pre-3.4 = "sumo thud warrior zeus dunfell gategarth hardknott"

BB_DANGLINGAPPENDS_WARNONLY = "1"

PREMIRRORS_prepend = "\
	https://github.com/LairdCP/Sterling-60-Release-Packages/releases/download/.*/.*     file://${TOPDIR}/../release \n\
	https://github.com/LairdCP/Sterling-LWB-and-LWB5-Release-Packages/releases/download/.*/.*     file://${TOPDIR}/../release \n\
	"
```

## meta-summit-radio/conf/layer.conf
```bitbake
# We have a conf and classes directory, add to BBPATH
BBPATH .= ":${LAYERDIR}"

# We have recipes-* directories, add to BBFILES
BBFILES += "${LAYERDIR}/recipes-*/*/*.bb \
	${LAYERDIR}/recipes-*/*/*.bbappend"

BBFILE_COLLECTIONS += "summit-radio"
BBFILE_PATTERN_summit-radio = "^${LAYERDIR}/"
BBFILE_PRIORITY_summit-radio = "8"

LAYERSERIES_COMPAT_summit-radio = "honister kirkstone langdale mickledore"

BB_DANGLINGAPPENDS_WARNONLY = "1"

PREMIRRORS:prepend = "https://github.com/LairdCP/Sterling-LWB-and-LWB5-Release-Packages/releases/download/.*/.*     file://${TOPDIR}/../release \n"
```
